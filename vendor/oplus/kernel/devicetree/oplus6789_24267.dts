// SPDX-License-Identifier: (GPL-2.0 OR MIT)
/*
 * Copyright (C) 2022 MediaTek Inc.
 */
/dts-v1/;
/plugin/;

&odm {
    /*OPLUS_FEATURE_OEM_OCDT oplus project start */
    oplus_project:oplus_project {
        compatible = "oplus,oplus_project";
    };

    oplus_boardid:oplus_boardid {
        compatible = "oplus,oplus_boardid";
        oplus_boardid,dtsino="24267";//only one u32
        oplus_boardid,pcbmask="0xffff";//all mask 0xffff
    };

    /*#endif OPLUS_FEATURE_TP_BASIC*/

};

/*End of this file, DO NOT ADD ANYTHING HERE*/

